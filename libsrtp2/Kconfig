## libsrtp2/Kconfig
```kconfig
menu "libsrtp2 (libsrtp)"

    config SRTP2_CRYPTO_MBEDTLS
        bool "Use mbedTLS as the libsrtp crypto backend"
        default y
        help
            Use mbedTLS for AES (ICM/GCM) and HMAC-SHA1 primitives.
            This is currently the only backend the ESP-IDF port wires up.

    config SRTP2_LOG_RTP_TRACE
        bool "Enable verbose RTP trace logging"
        default n
        help
            Enables libsrtp's internal debug-trace logging at runtime
            (extra binary size; meant only for development).

endmenu
```

## lua/examples/lua_example/sdkconfig.defaults
```kconfig
CONFIG_PARTITION_TABLE_CUSTOM=y
CONFIG_PARTITION_TABLE_CUSTOM_FILENAME="partitions.csv"
CONFIG_LUA_MAXSTACK=1000000
```

## network_provisioning/examples/thread_prov/sdkconfig.defaults
```kconfig
# Override some defaults so BT stack is enabled and
CONFIG_BT_ENABLED=y
CONFIG_BTDM_CTRL_MODE_BLE_ONLY=y
CONFIG_BTDM_CTRL_MODE_BR_EDR_ONLY=n
CONFIG_BTDM_CTRL_MODE_BTDM=n
CONFIG_BT_NIMBLE_ENABLED=y

## For Bluedroid as binary is larger than default size
CONFIG_PARTITION_TABLE_CUSTOM=y
CONFIG_PARTITION_TABLE_CUSTOM_FILENAME="partitions.csv"
CONFIG_PARTITION_TABLE_FILENAME="partitions.csv"

# mbedTLS
CONFIG_MBEDTLS_CMAC_C=y
CONFIG_MBEDTLS_SSL_PROTO_DTLS=y
CONFIG_MBEDTLS_KEY_EXCHANGE_ECJPAKE=y
CONFIG_MBEDTLS_ECJPAKE_C=y

# OpenThread
CONFIG_OPENTHREAD_ENABLED=y
CONFIG_OPENTHREAD_BORDER_ROUTER=n
CONFIG_OPENTHREAD_DNS64_CLIENT=y

# Network type
CONFIG_NETWORK_PROV_NETWORK_TYPE_THREAD=y

# LwIP
CONFIG_LWIP_TCPIP_TASK_STACK_SIZE=4096
CONFIG_LWIP_IPV6_NUM_ADDRESSES=8
CONFIG_LWIP_MULTICAST_PING=y
CONFIG_LWIP_HOOK_IP6_SELECT_SRC_ADDR_CUSTOM=y

# IEEE 802.15.4
CONFIG_IEEE802154_ENABLED=y
```

## network_provisioning/examples/wifi_prov/sdkconfig.defaults.esp32p4
```kconfig
# Override some defaults so BT stack is enabled
# in this example

CONFIG_FREERTOS_HZ=1000

# BT config
CONFIG_BT_ENABLED=y
CONFIG_BT_CONTROLLER_DISABLED=y
CONFIG_BT_BLUEDROID_ENABLED=n
CONFIG_BT_NIMBLE_ENABLED=y
CONFIG_BT_NIMBLE_TRANSPORT_UART=n

# Wi-Fi Remote
CONFIG_ESP_WIFI_REMOTE_LIBRARY_HOSTED=y

# Enable ESP Hosted BT
## Use Hosted-HCI (https://github.com/espressif/esp-hosted-mcu/blob/main/docs/bluetooth_design.md#3-bluetooth-interface)
CONFIG_ESP_HOSTED_ENABLE_BT_NIMBLE=y
CONFIG_ESP_HOSTED_NIMBLE_HCI_VHCI=y

# Wi-Fi performance config
CONFIG_WIFI_RMT_STATIC_RX_BUFFER_NUM=16
CONFIG_WIFI_RMT_DYNAMIC_RX_BUFFER_NUM=64
CONFIG_WIFI_RMT_DYNAMIC_TX_BUFFER_NUM=64
CONFIG_WIFI_RMT_AMPDU_TX_ENABLED=y
CONFIG_WIFI_RMT_TX_BA_WIN=32
CONFIG_WIFI_RMT_AMPDU_RX_ENABLED=y
CONFIG_WIFI_RMT_RX_BA_WIN=32

# LWIP performance config
CONFIG_LWIP_TCP_SND_BUF_DEFAULT=65534
CONFIG_LWIP_TCP_WND_DEFAULT=65534
CONFIG_LWIP_TCP_RECVMBOX_SIZE=64
CONFIG_LWIP_UDP_RECVMBOX_SIZE=64
CONFIG_LWIP_TCPIP_RECVMBOX_SIZE=64
CONFIG_LWIP_TCP_SACK_OUT=y
```

## onewire_bus/test_apps/main/Kconfig.projbuild
```kconfig
menu "Example Configuration"

    choice EXAMPLE_ONEWIRE_BACKEND
        prompt "1-Wire backend"
        default EXAMPLE_ONEWIRE_BACKEND_RMT if SOC_RMT_SUPPORTED
        default EXAMPLE_ONEWIRE_BACKEND_UART if SOC_UART_SUPPORTED
        help
            Select which low-level backend the test app uses.

        config EXAMPLE_ONEWIRE_BACKEND_RMT
            bool "RMT backend"
            depends on SOC_RMT_SUPPORTED

        config EXAMPLE_ONEWIRE_BACKEND_UART
            bool "UART backend"
            depends on SOC_UART_SUPPORTED
    endchoice

    config EXAMPLE_ONEWIRE_RMT_MAX_RX_BYTES
        int "RMT max receive bytes"
        depends on EXAMPLE_ONEWIRE_BACKEND_RMT
        default 10
        range 1 255
        help
            Largest single receive size for RMT backend.
            Recommended value: 10 (1byte ROM command + 8byte ROM number + 1byte device command)

    config EXAMPLE_ONEWIRE_UART_PORT_NUM
        int "UART port number"
        depends on EXAMPLE_ONEWIRE_BACKEND_UART
        default 1
        range 0 2
        help
            UART port used by UART backend.
            Valid UART port numbers differ across targets.
            Note: UART0 is typically used by the console output.

    config EXAMPLE_ONEWIRE_BUS_GPIO
        int "1-Wire data GPIO"
        default 0
        range 0 63
        help
            GPIO number used for the 1-Wire data line.
            Valid GPIO numbers depend on the selected target; choose a
            data-capable GPIO within this range for your chip.

    config EXAMPLE_ONEWIRE_ENABLE_INTERNAL_PULLUP
        bool "Enable internal pull-up"
        default y

    config EXAMPLE_ONEWIRE_MAX_DEVICES
        int "Maximum devices to search"
        default 2
        range 1 64

endmenu
```

## pid_ctrl/Kconfig
```kconfig
menu "PID Controller"

    config PID_CTRL_IQ_FORMAT
        int "IQmath Q-format (GLOBAL_IQ)"
        range 1 30
        default 24
        help
            Q-format used by the _iq backend. This value is applied as
            GLOBAL_IQ before including IQmathLib.h, so all _IQ() / _IQtoF()
            / _IQmpy() calls in pid_ctrl use this fractional bit count.

            Typical choices:
              - 24 (default): high precision, range approx. +/- 128.
              - 16         : more headroom, range approx. +/- 32768.
              - 8          : very large range, lower precision.

            If your application #defines GLOBAL_IQ itself before including
            pid_ctrl.h, that user definition wins and this option is ignored.

endmenu
```

## raylib/examples/esp32/m5stack-core2_hello/sdkconfig.defaults
```kconfig
# ESP-IDF Configuration
# Target is determined by the board selection

CONFIG_IDF_TARGET=esp32

# PSRAM Configuration for boards that support it
CONFIG_SPIRAM=y
CONFIG_SPIRAM_MODE_OCT=y
CONFIG_SPIRAM_MALLOC_ALWAYSINTERNAL=32768
```

## raylib/examples/esp32s3/espressif-esp-vocat_hello/sdkconfig.defaults
```kconfig
# ESP-IDF Configuration
# Target is determined by the board selection

CONFIG_IDF_TARGET=esp32s3

# PSRAM Configuration for boards that support it
CONFIG_SPIRAM=y
CONFIG_SPIRAM_MODE_OCT=y
CONFIG_SPIRAM_MALLOC_ALWAYSINTERNAL=32768
```

## raylib/templates/raylib-hello-c/sdkconfig.defaults
```kconfig
# ESP-IDF Configuration
# Target is determined by the board selection

//IF option("esp32_s3_box_3")
CONFIG_IDF_TARGET=esp32s3
//ELIF option("esp32_s3_box")
CONFIG_IDF_TARGET=esp32s3
//ELIF option("esp32_s3_lcd_ev_board")
CONFIG_IDF_TARGET=esp32s3
//ELIF option("esp32s3_korvo_2")
CONFIG_IDF_TARGET=esp32s3
//ELIF option("esp_vocat")
CONFIG_IDF_TARGET=esp32s3
//ELIF option("esp32_s3_eye")
CONFIG_IDF_TARGET=esp32s3
//ELIF option("m5stack_core_s3")
CONFIG_IDF_TARGET=esp32s3
//ELIF option("m5stack_atom_s3")
CONFIG_IDF_TARGET=esp32s3
//ELIF option("m5stack_atom_s3r")
CONFIG_IDF_TARGET=esp32s3
//ELIF option("m5stack_core_2")
CONFIG_IDF_TARGET=esp32
//ENDIF

# PSRAM Configuration for boards that support it
CONFIG_SPIRAM=y
CONFIG_SPIRAM_MODE_OCT=y
CONFIG_SPIRAM_MALLOC_ALWAYSINTERNAL=32768
```

## sh2lib/examples/http2_request/main/Kconfig.projbuild
```kconfig
menu "Example Configuration"

    config EXAMPLE_NGHTTP2_TASK_STACK_SIZE
        int "Nghttp2 task stack size"
        default 8192
        help
            This is the stack size for the nghttp task.

endmenu
```

## spi_nand_flash/host_test/sdkconfig.defaults
```kconfig
CONFIG_COMPILER_CXX_EXCEPTIONS=y
CONFIG_MMU_PAGE_SIZE=0X10000
CONFIG_NAND_ENABLE_STATS=y
```

## spi_nand_flash_fatfs/examples/nand_flash_bdl/main/Kconfig.projbuild
```kconfig
menu "SPI NAND BDL example configuration"

    config EXAMPLE_FORMAT_IF_MOUNT_FAILED
        bool "Format the flash if mount failed"
        default n
        help
            If set, format_if_mount_failed is true and the volume is formatted when mount fails.

    config EXAMPLE_FORMAT_BEFORE_MOUNT
        bool "Format the volume before mount (explicit mkfs)"
        default n
        help
            If set, the example calls esp_vfs_fat_nand_bdl_format() with the same
            esp_vfs_fat_mount_config_t (allocation unit, FAT count) before esp_vfs_fat_bdl_mount().
            Use this to force a filesystem layout that matches your mount_config without relying on
            format_if_mount_failed.

endmenu
```

## spi_nand_flash_fatfs/examples/nand_flash_bdl/sdkconfig.defaults
```kconfig
# FatFS BDL mount (esp_vfs_fat_bdl_*) needs IDF 6.1+; NAND BDL Kconfig needs IDF 6.0+.
CONFIG_NAND_FLASH_ENABLE_BDL=y
CONFIG_ESP_TASK_WDT_EN=n
```

## spi_nand_flash_vfs/examples/nand_flash_bdl/main/Kconfig.projbuild
```kconfig
menu "Example Configuration"

    config EXAMPLE_FORMAT_IF_MOUNT_FAILED
        bool "Format the file system if mount failed"
        default n
        help
            If this configuration is enabled, the example will format the file system
            if it fails to mount the file system.

endmenu
```

## supertinycron/Kconfig
```kconfig
menu "CRON Expression Parser"

    config CRON_DISABLE_YEARS
        bool "Disable support for parsing years"
        default n
        help
            When this option is selected, year parsing support will be disabled, reducing memory footprint  for cron_expr by 29 bytes.
            The library will still accept the year field. However, the field will not be validated and the cron event will be triggered every year.

endmenu
```

## test_app/sdkconfig.defaults
```kconfig
CONFIG_ESP_INT_WDT=n
CONFIG_ESP_TASK_WDT=n
CONFIG_ESPTOOLPY_FLASHSIZE_4MB=y
CONFIG_PARTITION_TABLE_CUSTOM=y
CONFIG_PARTITION_TABLE_CUSTOM_FILENAME="partitions.csv"
CONFIG_PARTITION_TABLE_FILENAME="partitions.csv"
```

## usb/test_app/sdkconfig.defaults
```kconfig
# Configure TinyUSB, it will be used to mock USB devices
CONFIG_TINYUSB=y
CONFIG_TINYUSB_MSC_ENABLED=y
CONFIG_TINYUSB_CDC_ENABLED=y
CONFIG_TINYUSB_CDC_COUNT=2
CONFIG_TINYUSB_HID_COUNT=2

# Disable watchdogs, they'd get triggered during unity interactive menu
CONFIG_ESP_INT_WDT=n
CONFIG_ESP_TASK_WDT=n

# Run-time checks of Heap and Stack
CONFIG_HEAP_POISONING_COMPREHENSIVE=y
CONFIG_COMPILER_STACK_CHECK_MODE_STRONG=y
CONFIG_COMPILER_STACK_CHECK=y

CONFIG_UNITY_ENABLE_BACKTRACE_ON_FAIL=y

CONFIG_COMPILER_CXX_EXCEPTIONS=y

CONFIG_PARTITION_TABLE_CUSTOM=y
CONFIG_PARTITION_TABLE_CUSTOM_FILENAME="partitions.csv"
CONFIG_PARTITION_TABLE_FILENAME="partitions.csv"
CONFIG_ESPTOOLPY_FLASHSIZE_4MB=y
CONFIG_WL_SECTOR_SIZE_512=y
CONFIG_WL_SECTOR_MODE_PERF=y

CONFIG_FATFS_LFN_HEAP=y
```
