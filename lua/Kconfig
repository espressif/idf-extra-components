## spi_nand_flash/Kconfig
```kconfig
menu "SPI NAND Flash configuration"

    config NAND_FLASH_VERIFY_WRITE
        bool "Verify SPI NAND flash writes"
        default n
        help
            If this option is enabled, any time SPI NAND flash is written then the data will be read
            back and verified. This can catch hardware problems with SPI NAND flash, or flash which
            was not erased before verification.

    config NAND_FLASH_ENABLE_BDL
        bool "Enable Block Device Layer (BDL) support"
        depends on IDF_INIT_VERSION >= "6.0"
        default n
        help
            Enable Block Device Layer (BDL) support for SPI NAND Flash. This provides:
            - Standard esp_blockdev_t interface for layered architecture
            - Flash Block Device Layer (raw NAND flash access)
            - Wear-Leveling Block Device Layer (logical sector access with wear leveling)
            - Advanced layered API (spi_nand_flash_init_with_layers)
            When disabled, only the legacy API is available.
            When enabled, the legacy spi_nand_flash_init_device() is not available (returns
            ESP_ERR_NOT_SUPPORTED). Use spi_nand_flash_init_with_layers().

            Note: This option requires ESP-IDF >= 6.0 (esp_blockdev component).
            Enabling this on ESP-IDF < 6.0 will result in a build error.

    config NAND_ENABLE_STATS
        bool "Host test statistics enabled"
        depends on IDF_TARGET_LINUX
        default n
        help
            This option enables gathering host test statistics and SPI NAND flash wear levelling simulation.

    config NAND_FLASH_GENERIC_CHIP_DETECTION
        bool "Enable generic SPI NAND chip detection"
        depends on NAND_FLASH_ENABLE_BDL && !IDF_TARGET_LINUX
        default n
        help
            When enabled, chip init bypasses the vendor database (including known JEDEC IDs)
            and uses ONFI parameter page geometry, falling back to
            NAND_FLASH_GENERIC_GEOMETRY_* when the parameter page is invalid.
            Access is via Flash BDL (nand_flash_get_blockdev) only: read-only by default,
            no Dhara/wear-leveling. Not for production FatFS mounts.
            When disabled, init is database-only (smaller binary).

    if NAND_FLASH_GENERIC_CHIP_DETECTION

        config NAND_FLASH_GENERIC_GEOMETRY_PAGE_SIZE
            int "Generic geometry fallback: page size in bytes"
            default 0
            range 0 8192
            help
                Used only when ONFI parameter page is missing or invalid.
                Data bytes per page from the datasheet. 0 means unset (parameter page required).
                When non-zero must be a power of two in 512..8192.

        config NAND_FLASH_GENERIC_GEOMETRY_PAGES_PER_BLOCK
            int "Generic geometry fallback: pages per block"
            default 0
            range 0 256
            help
                Used only when ONFI parameter page fails. 0 means unset.
                When non-zero must be a power of two in 32..256.

        config NAND_FLASH_GENERIC_GEOMETRY_NUM_BLOCKS
            int "Generic geometry fallback: number of blocks"
            default 0
            range 0 65536
            help
                Used only when ONFI parameter page fails. 0 means unset. Must be > 0 when used.

        config NAND_FLASH_GENERIC_NUM_PLANES
            int "Generic: number of planes"
            default 1
            range 1 4
            help
                Plane count for the generic path (ONFI or Kconfig geometry).
                Default 1 (single-plane). When > 1, program/read plane-select
                column addressing is enabled automatically. Set from the
                datasheet; incorrect values corrupt column addressing.

        config NAND_FLASH_GENERIC_T_R_US
            int "Generic: page read time (us)"
            default 100
            range 1 100000
            help
                Page read busy time (t_R). Used for Kconfig geometry, and when a
                CRC-valid ONFI page leaves tR at 0. A non-zero ONFI tR is kept.
                nand_wait_for_ready() times out at 10x this value. Prefer datasheet max.

        config NAND_FLASH_GENERIC_T_PROG_US
            int "Generic: page program time (us)"
            default 1000
            range 1 100000
            help
                Page program busy time (t_PROG). Used for Kconfig geometry, and when
                a CRC-valid ONFI page leaves tPROG at 0. A non-zero ONFI tPROG is kept.
                nand_wait_for_ready() times out at 10x this value. Prefer datasheet max.

        config NAND_FLASH_GENERIC_T_BERS_US
            int "Generic: block erase time (us)"
            default 10000
            range 1 1000000
            help
                Block erase busy time (t_BERS). Used for Kconfig geometry, and when
                a CRC-valid ONFI page leaves tBERS at 0. A non-zero ONFI tBERS is kept.
                nand_wait_for_ready() times out at 10x this value. Prefer datasheet max.

        config NAND_FLASH_GENERIC_WRITE_ERASE_ENABLE
            bool "Allow program/erase on generic chip path"
            default n
            help
                By default generic detection yields a read-only Flash BDL.
                Enable only for lab/bring-up on a disposable region; flash contents
                may change. Still does not enable wear-leveling or FatFS.

    endif

endmenu
```

## spi_nand_flash_fatfs/examples/nand_flash_fatfs_throughput/main/Kconfig.projbuild
```kconfig
menu "SPI NAND FatFs throughput example configuration"

    config EXAMPLE_TEST_TRIES
        int "Repeat count per (phase, chunk size) test cell"
        default 3
        range 1 5
        help
            Number of write+read passes per (phase, chunk size) cell,
            reported as mean/min/max throughput.

    config EXAMPLE_PRECONDITION_ENABLE
        bool "Precondition (age) the filesystem before measuring throughput"
        default y
        help
            Before the timed phases, write a fill file covering
            EXAMPLE_PRECONDITION_FILL_PERCENT of the volume's free space and
            keep it. The FTL then holds that much live data, so the timed
            phases run on a partly full device where garbage collection has
            to relocate live pages, instead of on a fresh chip.

    config EXAMPLE_PRECONDITION_FILL_PERCENT
        int "Percent of free space to precondition"
        depends on EXAMPLE_PRECONDITION_ENABLE
        default 20
        range 10 80
        help
            Size of the fill file as a percentage of the free space right
            after mount. The timed phases use the remaining space.

endmenu
```

## thorvg/Kconfig
```kconfig
menu "ThorVG Support Options"

    config THORVG_LOG_ENABLED
        bool "Enable ThorVG log"
        default n
        help
            Enable ThorVG log.

    menu "Loaders Support"

        config THORVG_LOTTIE_LOADER_SUPPORT
            bool "Enable Lottie loader support"
            default y

        config THORVG_SVG_LOADER_SUPPORT
            bool "Enable svg loader support"
            default y

        config THORVG_PNG_LOADER_SUPPORT
            bool "Enable png loader support"
            default n

        config THORVG_JPEG_LOADER_SUPPORT
            bool "Enable jpeg loader support"
            default n

        config THORVG_WEBP_LOADER_SUPPORT
            bool "Enable webp loader support"
            default n

        config THORVG_OTF_LOADER_SUPPORT
            bool "Enable OpenType (otf) font loader support"
            default n

        config THORVG_TTF_LOADER_SUPPORT
            bool "Enable TrueType (ttf) font loader support"
            default n

    endmenu

endmenu
```

## xymodem/Kconfig
```kconfig
menu "X/YModem"
    config XYMODEM_CANCEL_CAN_COUNT
        int "Number of <CAN> characters sent when canceling transmission"
        range 2 8
        default 2
        help
            X/YMODEM commonly uses two consecutive <CAN> characters to indicate
            transmission cancellation. Requiring multiple <CAN> characters reduces
            the risk of accidental cancellation caused by line errors.

            Sending additional <CAN> characters can make cancellation more reliable
            on noisy links, and some X/YMODEM specifications recommend sending eight
            <CAN> characters when aborting a transmission. This option specifies how
            many consecutive <CAN> characters are sent when canceling a transmission.

    config XYMODEM_CAN_INTERVAL_MS
        int "Maximum interval between consecutive <CAN> characters"
        range 1 1000
        default 100
        help
            Maximum interval, in milliseconds, allowed between two consecutive
            <CAN> characters when recognizing a cancellation request from the peer.

            X/YMODEM commonly uses two consecutive <CAN> characters to indicate
            transmission cancellation, but the protocol does not specify a maximum
            interval between them. A shorter interval reduces the chance of
            unrelated <CAN> characters being mistaken for a cancellation, while a
            longer interval improves compatibility with peers that transmit the
            characters with larger delays.

    config XYMODEM_PURGE_IDLE_TIMEOUT_MS
        int "RX idle time required when purging received data (ms)"
        range 0 1000
        default 10
        help
            Specifies how long the receive path must remain idle before the
            RX purge operation is considered complete.

            While purging, all received data is discarded. The idle timer is
            effectively restarted whenever more data is received. Please Set
            this value based on the actual transmission rate of the underlying
            physical link.

endmenu
```

## xymodem/examples/xmodem/main/Kconfig.projbuild
```kconfig
menu "Example Configuration"

    config EXAMPLE_XYMODEM_UART_PORT
        int "UART port number"
        default 1
        range 0 5
        help
            UART port used for the XMODEM link. Do not use the console UART (usually UART0)
            unless the console has been moved to another interface.

    config EXAMPLE_XYMODEM_UART_TX_GPIO
        int "UART TX GPIO"
        default 4
        range 0 63

    config EXAMPLE_XYMODEM_UART_RX_GPIO
        int "UART RX GPIO"
        default 5
        range 0 63

    config EXAMPLE_XYMODEM_UART_BAUD
        int "UART baud rate"
        default 115200
        range 9600 5000000

endmenu
```

## xymodem/test_apps/main/Kconfig.projbuild
```kconfig
menu "XYMODEM Test"

    config XYMODEM_TEST_UART_BAUD
        int "UART baud rate"
        default 115200
        range 9600 2000000
        help
            Baud rate used by both UART ports in the loopback test.

    config XYMODEM_TEST_SENDER_UART
        int "Sender UART port number"
        default 1
        range 1 5
        help
            UART port used by the sender. Do not use the console UART (usually UART0).

    config XYMODEM_TEST_RECEIVER_UART
        int "Receiver UART port number"
        default 2
        range 1 5
        help
            UART port used by the receiver. Must be different from the sender port.
            Requires a target with at least three UART controllers (for example ESP32 or ESP32-S3).

    config XYMODEM_TEST_GPIO_A
        int "GPIO for sender TX / receiver RX"
        default 4
        range 0 63
        help
            This GPIO is driven by the sender UART TX and sampled by the receiver UART RX
            through the GPIO matrix. No external jumper is required.

    config XYMODEM_TEST_GPIO_B
        int "GPIO for receiver TX / sender RX"
        default 5
        range 0 63
        help
            This GPIO is driven by the receiver UART TX and sampled by the sender UART RX
            through the GPIO matrix. No external jumper is required.

endmenu
```

## zlib/Kconfig
```kconfig
menu "zlib Configurations"
    config ZLIB_PREFER_PSRAM
        bool "Prefer PSRAM for zlib's own allocations"
        depends on SPIRAM
        default y
        help
            Route the memory zlib allocates for a deflate/inflate stream
            through heap_caps, so its large working buffers can live in PSRAM.
            Internal 8-bit RAM is used as a fallback when PSRAM is not
            initialized or cannot satisfy an allocation. Requests below 16 KiB
            keep preferring internal RAM.

            The gzip file APIs (gzopen, gzread, gzwrite) still use malloc()
            for their own state and I/O buffers.

            Only the allocator a z_stream uses for its own state and buffers
            is affected. The compression and decompression buffers an
            application passes in are its own, and are allocated by the
            application.

            A custom allocator installed in z_stream.zalloc/zfree always wins
            over this option, as zlib documents.
endmenu
```
