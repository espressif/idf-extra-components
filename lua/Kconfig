## lua/Kconfig
```kconfig
menu "Lua"
    config LUA_MAXSTACK
        int "Maximum Lua stack size (slots)"
        range 1000 1073741823
        default 1000000
        help
            Maximum number of Lua stack slots a lua_State may grow to.
            The unit is slots (Lua values), not bytes. Each slot holds
            one value and occupies about 8 bytes on 32-bit ESP targets.

            This is a growth cap, not a reservation. The stack starts
            small and expands on demand until it hits this limit.

            Size this cap together with the calling FreeRTOS task
            stack. Raising it does not grow the C stack: a 2 KB task
            stack will overflow long before a large Lua stack is
            usable.

    config LUA_USE_PSRAM
        bool "Prefer PSRAM for large Lua allocations"
        depends on SPIRAM
        default n
        help
            Route luaL_newstate() through a heap_caps allocator so large
            objects can live in PSRAM. A custom allocator passed to
            lua_newstate() is left unchanged.

            Allocations of 4 KiB or more (growing table arrays, long
            strings, a large Lua stack) prefer PSRAM. Smaller objects
            stay in internal RAM: the interpreter walks them randomly,
            which is slower in PSRAM. Either region is a fallback if
            the preferred heap cannot satisfy the request.
endmenu
```

## lz4/Kconfig
```kconfig
menu "LZ4 Configurations"

    config LZ4_USE_PSRAM
        bool "Prefer PSRAM for LZ4 internal allocations"
        default n
        help
            Prefer PSRAM for LZ4 Block and HC compression workspaces when
            available. Internal 8-bit RAM is used as a fallback when PSRAM is not
            initialized or cannot satisfy an allocation.

            This option enables LZ4_USER_MEMORY_FUNCTIONS. It affects allocations
            made by the Block and HC implementations. Frame APIs use their own
            custom-memory interface; use LZ4F_createCompressionContext_advanced()
            or LZ4F_createDecompressionContext_advanced() when Frame allocations
            must use a specific memory region. This option does not move
            application-owned input, output, or explicitly allocated streaming
            states automatically.

endmenu
```

## network_provisioning/examples/wifi_prov_ext_protocomm/main/Kconfig.projbuild
```kconfig
menu "Example Configuration"

    config EXAMPLE_PROV_TRANSPORT_BLE
        bool
        default y
        select BT_ENABLED
        depends on !IDF_TARGET_ESP32S2
        help
            This example uses BLE transport exclusively.

    choice EXAMPLE_PROV_SECURITY_VERSION
        bool "Protocomm security version"
        default EXAMPLE_PROV_SECURITY_VERSION_2
        help
            Network provisioning component offers 3 security versions.
            The example offers a choice between security version 1 and 2.

        config EXAMPLE_PROV_SECURITY_VERSION_1
            bool "Security version 1"
            select ESP_PROTOCOMM_SUPPORT_SECURITY_VERSION_1

        config EXAMPLE_PROV_SECURITY_VERSION_2
            bool "Security version 2"
            select ESP_PROTOCOMM_SUPPORT_SECURITY_VERSION_2
    endchoice

    choice EXAMPLE_PROV_MODE
        bool "Security version 2 mode"
        depends on EXAMPLE_PROV_SECURITY_VERSION_2
        default EXAMPLE_PROV_SEC2_DEV_MODE

        config EXAMPLE_PROV_SEC2_DEV_MODE
            bool "Security version 2 development mode"
            depends on EXAMPLE_PROV_SECURITY_VERSION_2
            help
                This enables the development mode for
                security version 2.
                Please note that this mode is NOT recommended for production purpose.

        config EXAMPLE_PROV_SEC2_PROD_MODE
            bool "Security version 2 production mode"
            depends on EXAMPLE_PROV_SECURITY_VERSION_2
            help
                This enables the production mode for
                security version 2.
    endchoice

    config EXAMPLE_PROV_USING_BLUEDROID
        bool
        depends on (BT_BLUEDROID_ENABLED && (IDF_TARGET_ESP32C3 || IDF_TARGET_ESP32S3))
        select BT_BLE_42_FEATURES_SUPPORTED
        default y
        help
            This enables BLE 4.2 features for Bluedroid.

    config EXAMPLE_PROV_SHOW_QR
        bool "Show provisioning QR code on terminal"
        default y
        help
            Display the provisioning QR code as ASCII art on the serial terminal
            in addition to printing the URL.

    config EXAMPLE_RESET_PROVISIONED
        bool
        default n
        prompt "Reset provisioned status on each boot"
        help
            Erases NVS so provisioning runs on every boot. Useful for testing.

endmenu
```

## raylib/Kconfig
```kconfig
menu "Raylib"

    config RAYLIB_USE_PSRAM
        bool "Place large raylib buffers in PSRAM"
        depends on SPIRAM
        default y
        help
            Let the software renderer allocate big blocks from PSRAM instead of internal RAM.

            Blocks of 32 KiB and above go to PSRAM first and fall back to internal RAM.
            Smaller blocks, which the renderer walks constantly, stay in internal RAM.

    choice RAYLIB_FRAMEBUFFER_FORMAT
        prompt "Framebuffer pixel format"
        default RAYLIB_FRAMEBUFFER_FORMAT_RGB565
        help
            The renderer draws into one buffer of this format; every frame is
            that buffer, converted, going out to the panel. Pick the format
            your panel and your RAM budget want.

        config RAYLIB_FRAMEBUFFER_FORMAT_RGB565
            bool "RGB565, 16 bpp"
            help
                Two bytes, R in bits 15:11, G in 10:5, B in 4:0.

        config RAYLIB_FRAMEBUFFER_FORMAT_RGB888
            bool "RGB888, 24 bpp"
            help
                Three bytes, R then G then B.

        config RAYLIB_FRAMEBUFFER_FORMAT_RGBA8888
            bool "RGBA8888, 32 bpp"
            help
                Four bytes, R then G then B then A.

        config RAYLIB_FRAMEBUFFER_FORMAT_RGB332
            bool "RGB332, 8 bpp"
            help
                One byte, R in bits 7:5, G in 4:2, B in 1:0.
    endchoice

    config RAYLIB_FRAMEBUFFER_COLOR_TYPE
        string
        default "R5G6B5" if RAYLIB_FRAMEBUFFER_FORMAT_RGB565
        default "R8G8B8" if RAYLIB_FRAMEBUFFER_FORMAT_RGB888
        default "R8G8B8A8" if RAYLIB_FRAMEBUFFER_FORMAT_RGBA8888
        default "R3G3B2" if RAYLIB_FRAMEBUFFER_FORMAT_RGB332

    menu "Resource loaders"

        config RAYLIB_FILEFORMAT_QOI
            bool "QOI image"
            default n
            help
                The cheapest loader that covers a typical game asset.

        config RAYLIB_FILEFORMAT_PNG
            bool "PNG image"
            default n
            help
                raylib carries its own PNG decoder, so this does not need
                zlib. It is worth a couple of kilobytes of flash.

        config RAYLIB_FILEFORMAT_BMP
            bool "BMP image"
            default n
            help
                Uncompressed pixels: the decoder is tiny, the files are not.

        config RAYLIB_FILEFORMAT_TGA
            bool "TGA image"
            default n
            help
                Uncompressed pixels via stb_image: a small decoder for a
                format art tools export without options to get wrong.

        config RAYLIB_FILEFORMAT_JPG
            bool "JPG image"
            default n
            help
                stb_image's JPEG decoder, worth a few kilobytes of flash:
                the format to reach for when the asset is a photograph.

        config RAYLIB_FILEFORMAT_GIF
            bool "GIF image"
            default n
            help
                Palette-based and at most 8 bits per pixel, but the only
                loader here that also reads animations (LoadImageAnim).

        config RAYLIB_FILEFORMAT_TTF
            bool "TTF font"
            default n
            help
                TrueType fonts for LoadFontEx(), rasterised into a texture
                atlas at load time through stb_truetype.

        config RAYLIB_FILEFORMAT_FNT
            bool "FNT font"
            default n
            help
                BMFont (.fnt) fonts for LoadFont(): glyphs come pre-rasterised
                in an atlas image, so no runtime rasteriser is needed. The
                atlas still loads through an image loader, so enable one
                (usually PNG) alongside.
    endmenu

endmenu
```

## raylib/examples/raylib-fireworks/sdkconfig.defaults.esp32p4
```kconfig
# CONFIG_ESP32P4_SELECTS_REV_LESS_V3 is not set
CONFIG_SPIRAM_MODE_HEX=y
CONFIG_SPIRAM_SPEED_200M=y
```

## soem/Kconfig
```kconfig
menu "SOEM Configuration"

    menu "Resource limits"

        config SOEM_EC_MAXBUF
            int "Frame buffers per channel"
            range 1 255
            default 16

        config SOEM_EC_MAXEEPBITMAP
            int "EEPROM bitmap cache size"
            default 128

        config SOEM_EC_LOGGROUPOFFSET
            int "Default group size exponent"
            default 16

        config SOEM_EC_MAXELIST
            int "Maximum error list entries"
            default 64

        config SOEM_EC_MAXNAME
            int "Maximum readable name length"
            default 40

        config SOEM_EC_MAXSLAVE
            int "Maximum number of slaves"
            range 2 200
            default 32

        config SOEM_EC_MAXGROUP
            int "Maximum number of groups"
            default 2

        config SOEM_EC_MAXIOSEGMENTS
            int "Maximum IO segments per group"
            default 64

        config SOEM_EC_MAXMBX
            int "Maximum mailbox size"
            default 1486

        config SOEM_EC_MBXPOOLSIZE
            int "Number of mailboxes in pool"
            default 32

        config SOEM_EC_MAXEEPDO
            hex "Maximum EEPROM PDO entries"
            default 0x200

        config SOEM_EC_MAXSM
            int "Maximum Sync Managers per slave"
            default 8

        config SOEM_EC_MAXFMMU
            int "Maximum FMMUs per slave"
            default 4

        config SOEM_EC_MAXLEN_ADAPTERNAME
            int "Maximum adapter name length"
            default 128

        config SOEM_EC_MAXODLIST
            int "Maximum Object Dictionary entries"
            default 1024

        config SOEM_EC_MAXOELIST
            int "Maximum Object Entry entries"
            default 256

        config SOEM_EC_SOE_MAXNAME
            int "Maximum SoE name length"
            default 60

        config SOEM_EC_SOE_MAXMAPPING
            int "Maximum SoE mappings"
            default 64

    endmenu

    menu "Timeouts and retries"

        config SOEM_EC_TIMEOUTRET
            int "Frame return timeout (us)"
            default 2000

        config SOEM_EC_TIMEOUTSAFE
            int "Safe return timeout (us)"
            default 20000

        config SOEM_EC_TIMEOUTEEP
            int "EEPROM access timeout (us)"
            default 20000

        config SOEM_EC_TIMEOUTTXM
            int "Mailbox transmit timeout (us)"
            default 20000

        config SOEM_EC_TIMEOUTRXM
            int "Mailbox receive timeout (us)"
            default 700000

        config SOEM_EC_TIMEOUTSTATE
            int "State transition timeout (us)"
            default 2000000

        config SOEM_EC_DEFAULTRETRIES
            int "Default number of retries"
            default 3

    endmenu

endmenu
```
