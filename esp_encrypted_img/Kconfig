## esp_schedule/examples/get_started/main/Kconfig.projbuild
```kconfig
menu "esp_schedule Example Configuration"

    choice ESP_SCHEDULE_EXAMPLE_PROV_SCHEME
        prompt "Network Provisioning Scheme"
        default ESP_SCHEDULE_EXAMPLE_PROV_SOFTAP
        help
            Select the network provisioning scheme for the ESP Schedule example.
            For BLE provisioning, please enable BT_ENABLED and BT_NIMBLE_ENABLED.

        config ESP_SCHEDULE_EXAMPLE_PROV_BLE
            bool "BLE Provisioning"
            depends on BT_ENABLED && BT_NIMBLE_ENABLED
            help
                Use Bluetooth Low Energy (BLE) for network provisioning.
                Requires a BLE-capable device and provisioning app.

        config ESP_SCHEDULE_EXAMPLE_PROV_SOFTAP
            bool "SoftAP Provisioning"
            help
                Use WiFi Soft Access Point for network provisioning.
                Creates a WiFi hotspot that users can connect to for provisioning.

    endchoice

    choice ESP_SCHEDULE_EXAMPLE_PROV_SECURITY_VERSION
        prompt "Provisioning security version"
        default ESP_SCHEDULE_EXAMPLE_PROV_SECURITY_VERSION_1 if ESP_PROTOCOMM_SUPPORT_SECURITY_VERSION_1
        default ESP_SCHEDULE_EXAMPLE_PROV_SECURITY_VERSION_2 if ESP_PROTOCOMM_SUPPORT_SECURITY_VERSION_2
        help
            Select the network provisioning security version.

        config ESP_SCHEDULE_EXAMPLE_PROV_SECURITY_VERSION_0
            bool "Security Version 0"
            depends on ESP_PROTOCOMM_SUPPORT_SECURITY_VERSION_0
            help
                Security version 0. No authentication is needed; plaintext communication.

        config ESP_SCHEDULE_EXAMPLE_PROV_SECURITY_VERSION_1
            bool "Security Version 1"
            depends on ESP_PROTOCOMM_SUPPORT_SECURITY_VERSION_1
            help
                Security version 1. The PoP is set to '12345678'.
                In production, please use a randomly generated PoP in a factory partition.

        config ESP_SCHEDULE_EXAMPLE_PROV_SECURITY_VERSION_2
            bool "Security Version 2"
            depends on ESP_PROTOCOMM_SUPPORT_SECURITY_VERSION_2
            help
                Security version 2. Username: 'wifiprov', Password: 'abcd1234'
                In production, please use a randomly generated username and password in a factory partition.

    endchoice

endmenu
```

## iqmath/test_apps/sdkconfig.defaults
```kconfig
CONFIG_UNITY_ENABLE_FIXTURE=n
CONFIG_UNITY_ENABLE_IDF_TEST_RUNNER=y

CONFIG_ESP_TASK_WDT_INIT=n
```

## isotp/examples/echo/main/Kconfig.projbuild
```kconfig
menu "ISO-TP Echo Configuration"
    menu "TWAI Basic Configuration"
        config EXAMPLE_TX_GPIO_NUM
            int "TX GPIO Number"
            default 5
            range 0 48
            help
                GPIO pin number for TWAI transmission.

        config EXAMPLE_RX_GPIO_NUM
            int "RX GPIO Number"
            default 4
            range 0 48
            help
                GPIO pin number for TWAI reception.

        config EXAMPLE_BITRATE
            int "TWAI Bitrate"
            default 500000
            range 25000 1000000
            help
                TWAI bitrate in bits per second.
                Common values: 125000, 250000, 500000, 1000000

        config EXAMPLE_TWAI_TX_QUEUE_DEPTH
            int "TWAI TX Queue Length"
            default 16
            range 1 64
            help
                Length of the TWAI transmit queue.

    endmenu

    menu "ISO-TP Configuration"
        config EXAMPLE_ISOTP_TX_ID
            hex "TX Message ID"
            default 0x7E0
            help
                CAN ID for transmitting ISO-TP messages.

        config EXAMPLE_ISOTP_RX_ID
            hex "RX Message ID"
            default 0x7E8
            help
                CAN ID for receiving ISO-TP messages.

        config EXAMPLE_BUFFER_SIZE
            int "Transfer Buffer Size"
            default 1024
            range 256 4096
            help
                Size of the buffer for ISO-TP message transfer.
                Must be large enough to handle the largest expected message.

        config EXAMPLE_ISOTP_TX_BUFFER_SIZE
            int "ISO-TP TX Buffer Size"
            default 4096
            range 256 8192
            help
                Size of the ISO-TP transmission buffer.

        config EXAMPLE_ISOTP_RX_BUFFER_SIZE
            int "ISO-TP RX Buffer Size"
            default 4096
            range 256 8192
            help
                Size of the ISO-TP reception buffer.
    endmenu

    menu "Task Configuration"
        config EXAMPLE_ISOTP_RX_QUEUE_SIZE
            int "Echo Queue Size"
            default 16
            range 1 32
            help
                Size of the queue for storing received messages.

        config EXAMPLE_ECHO_TASK_STACK_SIZE
            int "Task Stack Size"
            default 4096
            range 2048 32768
            help
                Stack size for the echo task.

        config EXAMPLE_ECHO_TASK_PRIORITY
            int "Task Priority"
            default 10
            range 1 25
            help
                FreeRTOS priority for the echo task.

        config EXAMPLE_ECHO_POLL_DELAY_MS
            int "Poll Interval (ms)"
            default 5
            range 1 100
            help
                Delay between consecutive ISO-TP protocol polls.
    endmenu
endmenu
```
