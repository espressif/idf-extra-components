## esp_encrypted_img/Kconfig
```kconfig
menu "Pre Encrypted OTA Configuration"

    choice PRE_ENCRYPTED_OTA_SCHEME
        prompt "Pre-encrypted OTA Scheme"
        default PRE_ENCRYPTED_OTA_USE_RSA
        help
            Select the cryptographic scheme to use for pre-encrypted Over-The-Air updates.

        config PRE_ENCRYPTED_OTA_USE_RSA
            bool "RSA-3072 encryption"
            help
                Use RSA for encrypting the GCM key.
                The device will decrypt the GCM key using its private RSA key.

        config PRE_ENCRYPTED_RSA_USE_DS
            depends on PRE_ENCRYPTED_OTA_USE_RSA
            depends on SOC_DIG_SIGN_SUPPORTED
            bool "Use DS Peripheral"
            help
                Use DS Peripheral for RSA OTA Encryption Scheme. The DS peripheral is used
                for decrypting the AES-GCM key

        config PRE_ENCRYPTED_OTA_USE_ECIES
            depends on SOC_HMAC_SUPPORTED
            select MBEDTLS_HKDF_C
            bool "ECIES encryption"
            help
                Use Elliptic Curve Cryptography (ECC) for key agreement.
                The GCM key will be derived using ECDH with a server public key
                and a device private key (potentially derived via HMAC).

    endchoice
endmenu
```

## esp_encrypted_img/examples/pre_encrypted_ota/main/Kconfig.projbuild
```kconfig
menu "Example Configuration"

    config EXAMPLE_FIRMWARE_UPGRADE_URL
        string "firmware upgrade url endpoint"
        default "https://192.168.0.3:8070/hello_world.bin"
        help
            URL of server which hosts the encrypted firmware image.

    config EXAMPLE_FIRMWARE_UPGRADE_URL_FROM_STDIN
        bool
        default y if EXAMPLE_FIRMWARE_UPGRADE_URL = "FROM_STDIN"

    config EXAMPLE_SKIP_COMMON_NAME_CHECK
        bool "Skip server certificate CN fieldcheck"
        default n
        help
            This allows you to skip the validation of OTA server certificate CN field.

    config EXAMPLE_SKIP_VERSION_CHECK
        bool "Skip firmware version check"
        default n
        help
            This allows you to skip the firmware version check.

    config EXAMPLE_OTA_RECV_TIMEOUT
        int "OTA Receive Timeout"
        default 5000
        help
            Maximum time for reception

    config EXAMPLE_ENABLE_PARTIAL_HTTP_DOWNLOAD
        bool "Enable partial HTTP download"
        default n
        select ESP_TLS_CLIENT_SESSION_TICKETS
        help
            This enables use of Range header in esp_https_ota component.
            The firmware image will be downloaded over multiple HTTP requests,
            with session resumption enabled between them.

    config EXAMPLE_HTTP_REQUEST_SIZE
        int "HTTP request size"
        default MBEDTLS_SSL_IN_CONTENT_LEN
        depends on EXAMPLE_ENABLE_PARTIAL_HTTP_DOWNLOAD
        help
            This options specifies HTTP request size. Number of bytes specified
            in this option will be downloaded in single HTTP request.

    config EXAMPLE_ENABLE_CI_TEST
        bool "Enable the CI test code"
        default n
        help
            This enables the CI test code i.e. https local server code.

    config EXAMPLE_USE_CERT_BUNDLE
        bool "Enable certificate bundle"
        default y
        depends on MBEDTLS_CERTIFICATE_BUNDLE
        help
            Enable trusted root certificate bundle. This approach allows to have
            OTA updates functional with any public server without requirement
            to explicitly add its server certificate.
endmenu
```

## esp_encrypted_img/examples/pre_encrypted_ota/sdkconfig.defaults
```kconfig
# Default sdkconfig parameters to use the OTA
# partition table layout, with a 4MB flash size
CONFIG_ESPTOOLPY_FLASHSIZE_4MB=y
CONFIG_PARTITION_TABLE_TWO_OTA=y
# Enable ESP HTTPS OTA decryption callback
CONFIG_ESP_HTTPS_OTA_DECRYPT_CB=y

# Certificate bundle configuration
CONFIG_MBEDTLS_CERTIFICATE_BUNDLE_DEFAULT_CMN=y
CONFIG_MBEDTLS_CUSTOM_CERTIFICATE_BUNDLE=y
CONFIG_MBEDTLS_CUSTOM_CERTIFICATE_BUNDLE_PATH="server_certs/ca_cert.pem"
```

## esp_foc/Kconfig
```kconfig
menu "espFoC Settings"

    config ESP_FOC_ALIGN_STEP_DELAY_MS
        int "Delay between rotor alignment step in ms"
        default 5
        help
            Keeps the bridge active with step calculated 
            voltages to ensure the Q and D vectors to
            align, higher values increase better alignment
            in excheange of rotor core saturation.

    config NOOF_AXIS
        int "Number of motor outputs"
        range 1 4
        default 1
        help
            The number of motor outputs available, this option
            is the number of motor sets, each set is composed 
            by total PWM outputs and sensor inputs.

    config FOC_TASK_PRIORITY
        int "Priority task of foc controller"
        range 16 25
        default 25

    config FOC_TASK_STACK_SIZE
        int "Task stack size of foc controller"
        default 3072
    
    config ESP_FOC_CUSTOM_MATH
        bool "Use custom espFoC fast math"
        default y

endmenu
    
    
    
```

## esp_gcov/Kconfig
```kconfig
menu "GNU Code Coverage"

    config ESP_GCOV_ENABLE
        bool "GCOV to Host Enable"
        depends on ESP_TRACE_TRANSPORT_APPTRACE && ESP_TRACE_LIB_NONE
        select ESP_DEBUG_STUBS_ENABLE
        select ESP_IPC_ENABLE
        default n
        help
            Enables support for GCOV data transfer to host.

    config ESP_GCOV_DUMP_TASK_STACK_SIZE
        int "Gcov dump task stack size"
        depends on ESP_GCOV_ENABLE
        default 2048
        help
            Configures stack size of Gcov dump task

endmenu
```

## esp_isotp/Kconfig
```kconfig
menu "ISO-TP Protocol"

    config ISO_TP_DEFAULT_BLOCK_SIZE
        int "Default Block Size"
        default 8
        range 1 32
        help
            Maximum number of consecutive frames the receiver can receive at one time.
            This value is affected by CAN driver queue length.
            Higher values improve throughput but require more buffer space.

    config ISO_TP_DEFAULT_ST_MIN_US
        int "Default STmin (microseconds)"
        default 1000
        range 0 50000
        help
            The STmin parameter specifies the minimum time gap allowed between
            the transmission of consecutive frame network protocol data units.
            0 = no delay, 1-50000 microseconds for timing control.

    config ISO_TP_MAX_WFT_NUMBER
        int "Maximum Wait Frame Number"
        default 1
        range 1 10
        help
            This parameter indicates how many FC N_PDU WTs (Wait frames) can be
            transmitted by the receiver in a row before giving up.

    config ISO_TP_DEFAULT_RESPONSE_TIMEOUT_US
        int "Default Response Timeout (microseconds)"
        default 100000
        range 10000 5000000
        help
            The default timeout to use when waiting for a response during a
            multi-frame send or receive operation.
            Common values: 100000 (100ms), 1000000 (1s).

    config ISO_TP_FRAME_PADDING
        bool "Enable Frame Padding"
        default n
        help
            Enable padding of ISO-TP message frames to full CAN frame size.
            When enabled, frames are padded with ISO_TP_FRAME_PADDING_VALUE.

    config ISO_TP_FRAME_PADDING_VALUE
        hex "Frame Padding Value"
        default 0xAA
        range 0x00 0xFF
        depends on ISO_TP_FRAME_PADDING
        help
            Value used for padding when ISO_TP_FRAME_PADDING is enabled.
            Common values: 0x00, 0xAA, 0xCC, 0xFF.

    config ISO_TP_USER_SEND_CAN_ARG
        bool "Enable User Send CAN Argument"
        default y
        help
            Determines if an additional argument is present in the
            definition of isotp_user_send_can function.

endmenu
```

## esp_isotp/examples/echo/main/Kconfig.projbuild
```kconfig
menu "ISO-TP Echo Configuration"
    menu "TWAI Basic Configuration"
        config EXAMPLE_TX_GPIO_NUM
            int "TX GPIO Number"
            default 5
            range 0 48
            help
                GPIO pin number for TWAI transmission.

        config EXAMPLE_RX_GPIO_NUM
            int "RX GPIO Number"
            default 4
            range 0 48
            help
                GPIO pin number for TWAI reception.

        config EXAMPLE_BITRATE
            int "TWAI Bitrate"
            default 500000
            range 25000 1000000
            help
                TWAI bitrate in bits per second.
                Common values: 125000, 250000, 500000, 1000000

        config EXAMPLE_TWAI_TX_QUEUE_DEPTH
            int "TWAI TX Queue Length"
            default 16
            range 1 64
            help
                Length of the TWAI transmit queue.

    endmenu

    menu "ISO-TP Configuration"
        config EXAMPLE_ISOTP_TX_ID
            hex "TX Message ID"
            default 0x7E8
            help
                TWAI ID for transmitting ISO-TP messages.

        config EXAMPLE_ISOTP_RX_ID
            hex "RX Message ID"
            default 0x7E0
            help
                TWAI ID for receiving ISO-TP messages.

        config EXAMPLE_ISOTP_TX_BUFFER_SIZE
            int "ISO-TP TX Buffer Size"
            default 4096
            range 256 8192
            help
                Size of the ISO-TP transmission buffer.

        config EXAMPLE_ISOTP_RX_BUFFER_SIZE
            int "ISO-TP RX Buffer Size"
            default 4096
            range 256 8192
            help
                Size of the ISO-TP reception buffer.

        config EXAMPLE_ISOTP_TX_FRAME_POOL_SIZE
            int "ISO-TP TX Frame Pool Size"
            default 8
            range 1 32
            help
                Number of TX frames in the ISO-TP transmission pool.
    endmenu

    menu "Task Configuration"
        config EXAMPLE_ECHO_TASK_STACK_SIZE
            int "Task Stack Size"
            default 4096
            range 2048 32768
            help
                Stack size for the echo task.

        config EXAMPLE_ECHO_TASK_PRIORITY
            int "Task Priority"
            default 10
            range 1 25
            help
                FreeRTOS priority for the echo task.

        config EXAMPLE_ECHO_POLL_DELAY_MS
            int "Poll Interval (ms)"
            default 1
            range 1 100
            help
                Delay between consecutive ISO-TP protocol polls.
    endmenu
endmenu
```

## esp_isotp/examples/echo/sdkconfig.defaults
```kconfig
CONFIG_TWAI_ISR_IN_IRAM=y
CONFIG_FREERTOS_HZ=1000
CONFIG_ISO_TP_DEFAULT_ST_MIN_US=3000
```

## esp_lcd_qemu_rgb/examples/lcd_qemu_rgb_panel/main/Kconfig.projbuild
```kconfig
menu "Example Configuration"

    config EXAMPLE_QEMU_RGB_PANEL_DEDIC_FB
        bool "Use QEMU RGB panel dedicated framebuffer"
        default "n"
        help
            Use QEMU RGB panel dedicated framebuffer as the framebuffer for LVGL.

    config EXAMPLE_QEMU_RGB_PANEL_STATIC
        bool "Static UI (for testing)"
        default "n"
        help
            If this option is enabled, example will not update the chart after
            it was drawn. This option is used in CI when testing the example.

endmenu
```

## esp_linenoise/Kconfig
```kconfig
menu "esp_linenoise configuration"
    config ESP_LINENOISE_MAX_INSTANCE_NB
        int "Maximum number of esp_linenoise instances that can be created simultaneously"
        range 1 32
        default 5
        help
            Specifies the maximum number of esp_linenoise instances that can be created simultaneously.
            This limitation applies only when esp_linenoise_abort is used, and the following note is
            relevant in that context.

            A dynamic memory allocation is performed when the first esp_linenoise instance is created and is
            freed once the last instance is deleted. The allocated memory size is proportional to the value
            set in this configuration. Therefore, it is recommended to keep this value as low as possible
            to reduce memory consumption while ensuring the application’s functional requirements are met.
endmenu
```

## esp_nand_ubi/Kconfig
```kconfig
menu "NAND UBI configuration"

    config ESP_NAND_UBI_ENABLE
        bool "Enable UBI-like layer for SPI NAND flash"
        depends on NAND_FLASH_ENABLE_BDL
        default n
        help
            Enables the esp_nand_ubi component. Requires CONFIG_NAND_FLASH_ENABLE_BDL
            and ESP-IDF >= 6.0. Provides position-independent factory images and
            bad-block hiding on SPI NAND flash by exposing a flat logical-erase-block
            (LEB) address space per volume above the raw NAND block device.

    config ESP_NAND_UBI_RESERVED_PEBS
        int "Default number of reserved PEBs for bad-block pool"
        depends on ESP_NAND_UBI_ENABLE
        range 0 32
        default 4
        help
            Number of physical erase blocks held back as a spare pool for bad-block
            replacement. Used as the default when nand_ubi_config_t.reserved_pebs is
            not overridden by the caller.

    config ESP_NAND_UBI_WL_ENABLE
        bool "Enable background wear-leveling FreeRTOS task (Phase 3)"
        depends on ESP_NAND_UBI_ENABLE
        default n
        help
            Enables a background wear-leveling task that migrates data from PEBs with
            high erase counts to PEBs with low erase counts. Not implemented in Phase 1.

    config ESP_NAND_UBI_WL_THRESHOLD
        int "Erase-count difference threshold to trigger a WL move"
        depends on ESP_NAND_UBI_WL_ENABLE
        default 4096
        help
            When the difference between the highest and lowest erase counts exceeds
            this threshold, the background wear-leveling task migrates a logical block.

endmenu
```

## esp_nand_ubi/host_test/sdkconfig.defaults
```kconfig
CONFIG_IDF_TARGET="linux"
CONFIG_NAND_FLASH_ENABLE_BDL=y
CONFIG_ESP_NAND_UBI_ENABLE=y
```

## esp_repl/Kconfig
```kconfig
menu "esp_repl configuration"

    config ESP_REPL_HAS_QUIT_CMD
        bool "Register quit command"
        default n
        help
            Register a static command "quit" that allows the user to return from the esp_repl main loop.
            The command is registered through the ESP_COMMAND_REGISTER macro provided by esp_commands component
            and is placed in the dedicated flash section.
endmenu
```

## esp_sccb_intf/Kconfig
```kconfig
menu "SCCB Configurations"

    config SCCB_ISR_IRAM_SAFE
        bool "Place SCCB ISR functions into IRAM"
        default n
        help
            Place SCCB ISR functions into IRAM.

endmenu
```
