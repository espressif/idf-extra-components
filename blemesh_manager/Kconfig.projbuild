## blemesh_manager/Kconfig.projbuild
```kconfig
menu "BLE Mesh Manager"

    config BLEMESH_MGR_ENABLE
        bool "Enable BLE Mesh Manager"
        default y
        select BT_ENABLED
        select BLE_MESH
        select BLE_MESH_PROVISIONER
        select BLE_MESH_PB_ADV
        select BLE_MESH_PB_GATT
        select BLE_MESH_CFG_CLI
        select BLE_MESH_GENERIC_ONOFF_CLI
        select BLE_MESH_GENERIC_LEVEL_CLI
        select BLE_MESH_LIGHT_LIGHTNESS_CLI
        select BLE_MESH_LIGHT_CTL_CLI
        select BLE_MESH_LIGHT_HSL_CLI
        select BLE_MESH_SENSOR_CLI
        select BLE_MESH_SETTINGS
        select BLE_MESH_PROVISIONER_RECV_HB
        help
            Enable the BLE Mesh Manager component. Pulls in all the
            ESP-BLE-MESH Kconfigs required for a provisioner with the
            v1 state catalogue.

    config BLEMESH_MGR_MAX_NODES
        int "Max nodes in volatile directory"
        depends on BLEMESH_MGR_ENABLE
        default BLE_MESH_MAX_PROV_NODES
        help
            Maximum number of provisioned nodes the manager tracks
            in its in-memory directory. The directory is volatile;
            it is rebuilt at runtime after reboot.

    config BLEMESH_MGR_TASK_STACK_SIZE
        int "Manager task stack size (bytes)"
        depends on BLEMESH_MGR_ENABLE
        default 6144

    config BLEMESH_MGR_TASK_PRIORITY
        int "Manager task priority"
        depends on BLEMESH_MGR_ENABLE
        default 5

    config BLEMESH_MGR_TASK_CORE_PIN
        int "Manager task core affinity (-1 = no affinity)"
        depends on BLEMESH_MGR_ENABLE
        default -1
        range -1 1

    config BLEMESH_MGR_QUEUE_LENGTH
        int "Manager task message queue length"
        depends on BLEMESH_MGR_ENABLE
        default 32

    config BLEMESH_MGR_INITIAL_SYNC_QUEUE_DEPTH
        int "Initial-state sync FIFO depth"
        depends on BLEMESH_MGR_ENABLE
        default 64
        help
            Maximum number of (node, state) initial-state Get
            requests that can be queued for paced dispatch. After a
            node is freshly provisioned or restored from NVS the
            manager schedules one to two Gets (depending on the
            node's profile) so the consumer learns the leaf's
            actual current state. A safe rule of thumb is
            2 x BLEMESH_MGR_MAX_NODES.

    config BLEMESH_MGR_INITIAL_SYNC_INTERVAL_MS
        int "Initial-state sync inter-Get interval (ms)"
        depends on BLEMESH_MGR_ENABLE
        default 250
        range 50 5000
        help
            Delay between consecutive initial-state Gets. Larger
            values reduce post-boot air-time bursts at the cost of
            slower convergence; smaller values converge faster but
            risk overrunning the mesh stack's segment buffers when
            many nodes are restored at once.

    config BLEMESH_MGR_CFG_STEP_RETRIES
        int "Per-step Config Client retry budget"
        depends on BLEMESH_MGR_ENABLE
        default 3
        range 0 10
        help
            How many times the configurator re-sends a single
            Config Client request (Composition Data Get, AppKey
            Add, Model App Bind, Model Pub Set, Heartbeat Pub Set,
            Default TTL Set) if the leaf doesn't reply within
            BLE_MESH_CLIENT_MSG_TIMEOUT. Without retries a single
            dropped STATUS — common on rich multi-element lights
            because each provisioning burst issues ~14 binds in
            ~1 s and the radio may be contended with other BLE
            activity — aborts the whole node and factory-resets the
            leaf, so the consumer never learns about it. A budget of 3 yields four total
            attempts per step (initial + 3 retries) which has
            absorbed every transient timeout observed in the lab
            without meaningfully slowing happy-path provisioning.
            Set to 0 to restore the previous abort-on-first-timeout
            behaviour.

endmenu
```

## blemesh_manager/examples/repl_demo/sdkconfig.defaults
```kconfig
# BLE Mesh Manager example — sdkconfig defaults.
#
# Only what the component's Kconfig (BLEMESH_MGR_ENABLE) cannot provide lives
# here: the BT-host choice, numeric tunables (select can't set int values),
# and app/board policy. The mesh role + all Client models + SETTINGS + RECV_HB
# are select'ed by the component, so they are intentionally NOT repeated below.

# App / board policy
CONFIG_PARTITION_TABLE_SINGLE_APP_LARGE=y
CONFIG_ESP_CONSOLE_UART_DEFAULT=y
CONFIG_ESP_SYSTEM_PANIC_PRINT_REBOOT=y
CONFIG_FREERTOS_HZ=1000

# BLE host — application choice (the component is host-agnostic; this is a
# Kconfig `choice` and cannot be select'ed). NimBLE is lighter and is what the
# manager was tuned on; swap to CONFIG_BT_BLUEDROID_ENABLED=y to use Bluedroid.
CONFIG_BT_NIMBLE_ENABLED=y
CONFIG_BT_NIMBLE_LOG_LEVEL_WARNING=y

# Provisioner only (can't be expressed as a select — it's a `=n`).
CONFIG_BLE_MESH_NODE=n

# Mesh-stack scan duplicate filtering — critical with many beaconing nodes.
# Without it the host is flooded with duplicate adv reports, which stalls
# connection attempts (cancelled GATT connects) and provisioning.
# The controller-level knobs live in the per-target defaults files because the
# symbols differ by chip: esp32 uses BTDM_* (sdkconfig.defaults.esp32), every
# other chip uses BT_CTRL_* (sdkconfig.defaults.btctrl, wired in CMakeLists).
CONFIG_BLE_MESH_USE_DUPLICATE_SCAN=y
CONFIG_BLE_MESH_SUPPORT_BLE_ADV=y

# Numeric tunables — `select` can't set int values, so these stay app-side.
# Segmentation + cache budgets for back-to-back Config Client bursts.
CONFIG_BLE_MESH_TX_SEG_MSG_COUNT=8
CONFIG_BLE_MESH_RX_SEG_MSG_COUNT=8
CONFIG_BLE_MESH_MSG_CACHE_SIZE=20
# Stack fallback timeout (used only where a caller passes msg_timeout=0). The
# manager paths pass cfg.set_confirm_timeout_ms explicitly — see app_main.
CONFIG_BLE_MESH_CLIENT_MSG_TIMEOUT=10000
CONFIG_BLE_MESH_MAX_PROV_NODES=20
```

## blemesh_manager/examples/repl_demo/sdkconfig.defaults.btctrl
```kconfig
# Controller scan-duplicate knobs — BT_CTRL_* naming.
# Chips: esp32c3, esp32s3. Wired in via SDKCONFIG_DEFAULTS in CMakeLists.txt.
CONFIG_BT_CTRL_BLE_MESH_SCAN_DUPL_EN=y
CONFIG_BT_CTRL_SCAN_DUPL_TYPE_DATA_DEVICE=y
CONFIG_BT_CTRL_MESH_DUPL_SCAN_CACHE_SIZE=100
```

## blemesh_manager/examples/repl_demo/sdkconfig.defaults.btdm
```kconfig
# Controller scan-duplicate knobs — BTDM_* naming (legacy dual-mode controller).
# Chips: esp32. Wired in via SDKCONFIG_DEFAULTS in CMakeLists.txt.
CONFIG_BTDM_BLE_MESH_SCAN_DUPL_EN=y
CONFIG_BTDM_SCAN_DUPL_TYPE_DATA_DEVICE=y
CONFIG_BTDM_MESH_DUPL_SCAN_CACHE_SIZE=100
```

## blemesh_manager/examples/repl_demo/sdkconfig.defaults.btle
```kconfig
# Controller scan-duplicate knobs — BT_LE_* naming (NimBLE-era controller).
# Chips: esp32c5, esp32c6, esp32c61, esp32h2. The mesh-specific cache symbol is
# gone here; the generic duplicate-scan list is used instead.
# Wired in via SDKCONFIG_DEFAULTS in CMakeLists.txt.
CONFIG_BT_LE_SCAN_DUPL=y
CONFIG_BT_LE_SCAN_DUPL_TYPE_DATA_DEVICE=y
CONFIG_BT_LE_LL_DUP_SCAN_LIST_COUNT=100
```

## blemesh_manager/test_apps/sdkconfig.defaults
```kconfig
# BLE Mesh Manager test app — sdkconfig defaults.
# The component's BLEMESH_MGR_ENABLE select-chain pulls in the BLE Mesh flags;
# these make the BT controller + Bluedroid config explicit so the component
# (and the esp_ble_mesh headers the tests include) build cleanly.
CONFIG_BT_ENABLED=y
CONFIG_BT_BLUEDROID_ENABLED=y
CONFIG_BT_BLE_ENABLED=y
CONFIG_BT_BLE_42_FEATURES_SUPPORTED=y
CONFIG_BT_BLE_50_FEATURES_SUPPORTED=n

CONFIG_BLE_MESH=y
CONFIG_BLE_MESH_PROVISIONER=y
CONFIG_BLE_MESH_NODE=n
CONFIG_BLE_MESH_PB_ADV=y
CONFIG_BLE_MESH_PB_GATT=y
CONFIG_BLE_MESH_CFG_CLI=y
CONFIG_BLE_MESH_GENERIC_ONOFF_CLI=y
CONFIG_BLE_MESH_GENERIC_LEVEL_CLI=y
CONFIG_BLE_MESH_LIGHT_LIGHTNESS_CLI=y
CONFIG_BLE_MESH_LIGHT_CTL_CLI=y
CONFIG_BLE_MESH_LIGHT_HSL_CLI=y
CONFIG_BLE_MESH_SENSOR_CLI=y
CONFIG_BLE_MESH_SETTINGS=y
CONFIG_BLE_MESH_PROVISIONER_RECV_HB=y

CONFIG_BLEMESH_MGR_ENABLE=y
```

## canopennode/Kconfig
```kconfig
menu "CANopenNode Stack Config"

    config CO_SDO_SERVER
        bool "Enable SDO server"
        default y
        help
            Enable the CANopen SDO server (CiA 301). Allows remote nodes and
            tools (e.g. PCAN-View, CANopen Magic) to read/write entries in
            the local Object Dictionary via SDO transfers. Includes support
            for expedited and segmented transfers (CO_SDOserver.c).

    config CO_SDO_CLIENT
        bool "Enable SDO client"
        default n
        help
            Enable the CANopen SDO client (CiA 301). Allows this node to
            initiate SDO uploads/downloads to other CANopen nodes. This adds
            the SDO client state machine and FIFO support needed by
            CO_SDOclient.c.

    config CO_MULTIPLE_OD
        bool "Enable MULTIPLE_OD"
        default false
        help
            Enable CANopenNode support for multiple Object Dictionaries.
            When enabled, CANopen parameters are provided through CO_config_t
            at CO_new() time. When disabled, CANopenNode uses the default
            OD.h definitions directly, which lowers memory consumption and
            startup time.

endmenu
```

## ccronexpr/Kconfig
```kconfig
menu "CRON Expression Parser"

    config CRON_DISABLE_YEARS
        bool "Disable support for parsing years"
        default n
        help
            Enable it will lower memory footriprint by 29 bytes for cron_expr.
            It will still accept year field, but field will not be validated and it will be triggered every year.

endmenu
```

## cjson/Kconfig
```kconfig
menu "cJSON"

    config CJSON_NESTING_LIMIT
        int "Maximum nesting depth for JSON parsing"
        default 1000
        help
            Limits how deeply nested arrays/objects can be before cJSON
            rejects to parse them. This is to prevent stack overflows.
            Lower values use less stack, higher values allow deeper nesting.

endmenu
```

## coap/Kconfig
```kconfig
menu "CoAP Configuration"
    config COAP_MBEDTLS_PSK
        bool "Pre-Shared Keys"
        default y
        help
            If the CoAP information is to be encrypted, the encryption environment
            can be set up using Pre-Shared keys (PSK) mode.

            - Encrypt using defined Pre-Shared Keys (PSK if uri includes coaps://)
            - Note: If PKI is set as well, a server will decide which method to use
                    based on the incoming encryption request. It is up to the client
                    logic to decide which one to use.

    config COAP_MBEDTLS_PKI
        bool "PKI Certificates"
        default n
        help
            If the CoAP information is to be encrypted, the encryption environment
            can be set up using Public Key Infrastructure (PKI) mode.

            - Encrypt using defined Public Key Infrastructure (PKI if uri includes coaps://)
            - Note: If PSK is set as well, a server will decide which method to use
                    based on the incoming encryption request. It is up to the client
                    logic to decide which one to use.

    config COAP_DEBUGGING
        bool "Enable CoAP debugging"
        default n
        help
            Enable CoAP debugging functions at compile time for the example code.

            If this option is enabled, call coap_set_log_level()
            at runtime in order to enable CoAP debug output via the ESP
            log mechanism.

            Note: The Mbed TLS library logging is controlled by the mbedTLS
            configuration, but logging level mbedTLS must be set for CoAP
            to log it.

    choice COAP_DEBUGGING_LEVEL
        bool "Set CoAP debugging level"
        depends on COAP_DEBUGGING
        default COAP_LOG_WARNING
        help
            Set CoAP debugging level

        config COAP_LOG_EMERG
            bool "Emergency"
        config COAP_LOG_ALERT
            bool "Alert"
        config COAP_LOG_CRIT
            bool "Critical"
        config COAP_LOG_ERROR
            bool "Error"
        config COAP_LOG_WARNING
            bool "Warning"
        config COAP_LOG_NOTICE
            bool "Notice"
        config COAP_LOG_INFO
            bool "Info"
        config COAP_LOG_DEBUG
            bool "Debug"
        config COAP_LOG_OSCORE
            bool "OSCORE"
    endchoice

    config COAP_LOG_DEFAULT_LEVEL
        int
        default 0 if !COAP_DEBUGGING
        default 0 if COAP_LOG_EMERG
        default 1 if COAP_LOG_ALERT
        default 2 if COAP_LOG_CRIT
        default 3 if COAP_LOG_ERROR
        default 4 if COAP_LOG_WARNING
        default 5 if COAP_LOG_NOTICE
        default 6 if COAP_LOG_INFO
        default 7 if COAP_LOG_DEBUG
        default 8 if COAP_LOG_OSCORE

    config COAP_TCP_SUPPORT
        bool "Enable TCP within CoAP"
        default y
        help
            Enable TCP functionality for CoAP. This is required if TLS sessions
            are to be used.

            If this option is disabled, redundant CoAP TCP code is removed.

    config COAP_OSCORE_SUPPORT
        bool "Enable OSCORE support within CoAP"
        default n
        help
            Enable OSCORE (Object Security for Constrained RESTful Environments) functionality for CoAP.

            If this option is disabled, redundant CoAP OSCORE code is removed.

    config COAP_OBSERVE_PERSIST
        bool "Enable Server Observe Persist support within CoAP"
        default n
        help
            Enable Server Observe Persist support for CoAP.

            If this option is disabled, redundant CoAP Observe Persist code is removed.

    config COAP_WEBSOCKETS
        bool "Enable WebSockets support within CoAP"
        default n
        help
            Enable WebSockets support for CoAP.

            If this option is disabled, redundant CoAP WebSocket code is removed.

    config COAP_CLIENT_SUPPORT
        bool "Enable Client functionality within CoAP"
        default n
        help
            Enable client functionality (ability to make requests and receive
            responses) for CoAP. If the server is going to act as a proxy, then
            this needs to be enabled to support the ongoing session going to
            the next hop.

            If this option is disabled, redundant CoAP client only code is removed.
            If both this option and COAP_SERVER_SUPPORT are disabled, then both
            are automatically enabled for backwards compatability.

    config COAP_SERVER_SUPPORT
        bool "Enable Server functionality within CoAP"
        default n
        help
            Enable server functionality (ability to receive requests and send
            responses) for CoAP.

            If this option is disabled, redundant CoAP server only code is removed.
            If both this option and COAP_CLIENT_SUPPORT are disabled, then both
            are automatically enabled for backwards compatability.

endmenu
```

## coap/examples/coap_server/sdkconfig.defaults
```kconfig
CONFIG_MBEDTLS_SSL_PROTO_DTLS=y
CONFIG_MBEDTLS_PSK_MODES=y
CONFIG_MBEDTLS_KEY_EXCHANGE_PSK=y
CONFIG_LWIP_NETBUF_RECVINFO=y
CONFIG_COAP_SERVER_SUPPORT=y

CONFIG_PARTITION_TABLE_CUSTOM=y
CONFIG_PARTITION_TABLE_CUSTOM_FILENAME="partitions.csv"
CONFIG_PARTITION_TABLE_FILENAME="partitions.csv"
```

## coremark/examples/coremark_example/sdkconfig.defaults.esp32
```kconfig
CONFIG_ESP_DEFAULT_CPU_FREQ_MHZ_240=y
# for IDF v4.4.x compatibility
CONFIG_ESP32_DEFAULT_CPU_FREQ_240=y
```

## coremark/examples/coremark_example/sdkconfig.defaults.esp32s2
```kconfig
CONFIG_ESP_DEFAULT_CPU_FREQ_MHZ_240=y
# for IDF v4.4.x compatibility
CONFIG_ESP32S2_DEFAULT_CPU_FREQ_240=y
```

## coremark/examples/coremark_example/sdkconfig.defaults.esp32s3
```kconfig
CONFIG_ESP_DEFAULT_CPU_FREQ_MHZ_240=y
# for IDF v4.4.x compatibility
CONFIG_ESP32S3_DEFAULT_CPU_FREQ_240=y
```
