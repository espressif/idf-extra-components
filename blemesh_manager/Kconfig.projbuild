## eigen/examples/svd/sdkconfig.defaults
```kconfig
#
# Common ESP-related
#
# CONFIG_ESP_TIMER_PROFILING is not set
CONFIG_ESP_MAIN_TASK_STACK_SIZE=16384
```

## esp_cli/Kconfig
```kconfig
menu "esp_cli configuration"

    config ESP_CLI_HAS_QUIT_CMD
        bool "Register quit command"
        default n
        help
            Register a static command "quit" that allows the user to return from the esp_cli main loop.
            The command is registered through the ESP_CLI_COMMAND_REGISTER macro provided by esp_cli_commands component
            and is placed in the dedicated flash section.
endmenu
```

## esp_cli/examples/lifecycle_hooks/sdkconfig.defaults.esp32
```kconfig
# Use custom partition table with SPIFFS partition
CONFIG_PARTITION_TABLE_CUSTOM=y
CONFIG_PARTITION_TABLE_CUSTOM_FILENAME="partitions.csv"
```

## esp_cli/examples/multi_instance/sdkconfig.defaults
```kconfig
CONFIG_ESP_CLI_HAS_QUIT_CMD=y
CONFIG_ESP_LINENOISE_MAX_INSTANCE_NB=2
CONFIG_ESP_TASK_WDT_EN=n
CONFIG_VFS_SUPPORT_IO=y
```

## esp_custom_part_ota/examples/custom_part_ota_example/main/Kconfig.projbuild
```kconfig
menu "Example Configuration"

    orsource "$IDF_PATH/examples/common_components/env_caps/$IDF_TARGET/Kconfig.env_caps"

    config EXAMPLE_DATA_DOWNLOAD_URL
        string "Data Download URL"
        default "https://192.168.2.106:8070/data.bin"
        help
            URL of server which hosts the firmware image.

    config EXAMPLE_DATA_DOWNLOAD_URL_FROM_STDIN
        bool
        default y if EXAMPLE_FIRMWARE_UPG_URL = "FROM_STDIN"

    config EXAMPLE_SKIP_COMMON_NAME_CHECK
        bool "Skip server certificate CN fieldcheck"
        default n
        help
            This allows you to skip the validation of OTA server certificate CN field.

    config EXAMPLE_OTA_RECV_TIMEOUT
        int "OTA Receive Timeout"
        default 5000
        help
            Maximum time for reception

    config EXAMPLE_PARTITION_BACKUP
        bool "Backup the Update Partition"
        default y
        help
            Backup the data of the partition to be updated
endmenu
```
