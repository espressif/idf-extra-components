## clarke_park/Kconfig
```kconfig
menu "Clarke Park Transform"

    config CLARKE_PARK_IQ_FORMAT
        int "IQmath Q-format (GLOBAL_IQ)"
        range 1 29
        default 15
        help
            Q-format used by the _iq backend. This value is applied as
            GLOBAL_IQ before including IQmathLib.h, so all _IQ() / _IQtoF()
            / _IQmpy() calls in clarke_park use this fractional bit count.

            Typical choices:
              - 15 : matches the CORDIC hardware, approx. +/- 1 range.
              - 24 : higher precision, range approx. +/- 128.
              - 8  : very large range, lower precision.

            If your application #defines GLOBAL_IQ itself before including
            clarke_park.h, that value must match this option
            (CONFIG_CLARKE_PARK_IQ_FORMAT).

endmenu
```

## dhara/Kconfig
```kconfig
menu "Dhara FTL Configuration"

    config DHARA_MAP_PATH_CACHE
        bool "Enable sequential-locality path cache in dhara_map"
        default y
        help
            Caches the last successful read-only dhara_map_find() path
            traversal. Consecutive sector lookups that share a common
            radix-tree prefix with the previous lookup skip the
            already-known levels, reducing dhara_journal_read_meta() calls
            for sequential sector access patterns.

            This grows in-RAM struct dhara_map by 140 bytes. Disable this to
            recover that RAM at the cost of losing the read-path speedup.

endmenu
```

## esp_schedule/Kconfig
```kconfig
menu "ESP Schedule Configuration"

    config ESP_SCHEDULE_DISABLE_DEFAULT_PORT
        bool "Do not build the default ESP-IDF port"
        default n
        help
            Exclude esp_schedule_init() and the ESP-IDF implementations of the
            platform operations it installs - FreeRTOS software timers,
            nvs_flash storage, SNTP time and esp_log logging - from the build.

            Note that the default port runs schedule callbacks on the shared
            FreeRTOS timer daemon task, which needs
            CONFIG_FREERTOS_TIMER_TASK_STACK_DEPTH raised to at least 3072; see
            "Timer Task Stack Requirement" in the component README. A port of
            your own that dispatches on its own task avoids that.

            You do not need this just to use your own port. The default port
            already costs nothing at run time: it lives in its own object files,
            referenced only by esp_schedule_init(), so an application calling
            esp_schedule_init_with_config() never links it in the first place.

            Enable this only when those sources must not be compiled at all.
            esp_schedule_init() then does not exist, and
            esp_schedule_init_with_config() becomes the only entry point.

    config ESP_SCHEDULE_ENABLE_DAYLIGHT
        bool "Enable Daylight (Sunrise/Sunset) Schedules"
        default y
        help
            Enable support for sunrise and sunset based schedules.

            This feature allows scheduling based on astronomical calculations
            for sunrise and sunset times at specific geographical locations.

            Disabling this option will:
            - Remove sunrise/sunset schedule types from the API
            - Save memory by excluding solar calculation code
            - Reduce binary size (by about 11500 bytes)

            If disabled, ESP_SCHEDULE_TYPE_SUNRISE and ESP_SCHEDULE_TYPE_SUNSET
            will not be available.

    config ESP_SCHEDULE_ENABLE_SNTP
        bool "Start SNTP from esp_schedule_init()"
        default y
        help
            Whether the default ESP-IDF port starts SNTP when esp_schedule_init()
            installs it.

            Disable this if the clock comes from somewhere else - an RTC, or a
            time set by the application over a link with no internet access.
            esp_schedule needs a valid wall clock but does not care who set it;
            with this disabled it reads wall time and never touches the network.

            Disabling also drops the esp_sntp dependency rather than leaving it
            linked and unused.

            Note that esp_schedule still refuses to arm a schedule until the
            clock reads past 2020, so whatever sets the time must do so before
            enabling schedules.

    config ESP_SCHEDULE_LOG_LEVEL_OVERRIDE
        bool "Set a log level for esp_schedule separate from the global one"
        default n
        help
            By default esp_schedule follows CONFIG_LOG_MAXIMUM_LEVEL. Enable
            this to give the component its own ceiling instead.

            Calls above the ceiling are removed by the preprocessor, format
            string included, so lowering it saves flash and - because schedule
            callbacks run on the FreeRTOS timer daemon task - stack. See
            "Timer Task Stack Requirement" in the component README.

    config ESP_SCHEDULE_LOG_LEVEL
        int "esp_schedule log level"
        depends on ESP_SCHEDULE_LOG_LEVEL_OVERRIDE
        range -1 4
        default 2
        help
            Highest severity esp_schedule will emit: -1 none, 0 error, 1 warn,
            2 info, 3 debug, 4 verbose.

            This is esp_schedule_log_level_t, which starts at error = 0. It is
            not esp_log_level_t, which reserves 0 for none.

endmenu
```

## esp_suit_ota/Kconfig
```kconfig
menu "ESP SUIT OTA"

    config ESP_SUIT_OTA_ENVELOPE_BUF
        int "Envelope arena size (bytes)"
        default 4096
        range 1024 65536
        help
            Memory kept for the authentication wrapper, the manifest and any severed
            install or payload-fetch section. An envelope whose header does not fit
            is rejected before anything is buffered.

    config ESP_SUIT_OTA_AUTH_MAX
        int "Largest accepted authentication wrapper (bytes)"
        default 512
        range 128 4096

    config ESP_SUIT_OTA_MAX_COMPONENTS
        int "Largest accepted component count per manifest"
        default 8
        range 1 16

    config ESP_SUIT_OTA_MAX_NESTING
        int "Deepest try-each or run-sequence nesting"
        default 4
        range 1 8

    config ESP_SUIT_OTA_REQUIRE_ID_CHECKS
        bool "Require vendor and class identifier checks in the shared sequence"
        default y
        help
            The standard only recommends the checks (draft-ietf-suit-manifest section
            6.2). With this option a manifest without them is rejected.

    config ESP_SUIT_OTA_SKIP_IF_INSTALLED
        bool "Skip components whose live partition already matches the manifest digest"
        default y

    config ESP_SUIT_OTA_JOURNAL_KB
        int "Journal the write position every N KB"
        default 64
        range 4 1024

    config ESP_SUIT_OTA_INITIAL_SEQ
        int "Sequence number floor baked into this firmware"
        default 0
        help
            Manifests with a sequence number below this value are rejected even when
            the installed record was erased. Set it to the number of the release that
            carries this firmware. The manifest generator reads it from sdkconfig.

    config ESP_SUIT_OTA_TEXT_LANG
        string "Language tag of the update description to keep"
        default "en"

    config ESP_SUIT_OTA_TEXT_CAP
        int "Largest kept update description (bytes)"
        default 256
        range 32 1024

    config ESP_SUIT_OTA_URI_MAX
        int "Largest accepted component URI (bytes)"
        default 192
        range 64 512

    config ESP_SUIT_OTA_EVENT_POST_TIMEOUT
        int "Event post timeout (ms), -1 waits forever"
        default 2000
        range -1 60000

    config ESP_SUIT_OTA_HTTPS_ALLOW_HTTP
        bool "Allow plain HTTP for the manifest and payload downloads"
        default n
        help
            Without this option the HTTPS getter requires server verification
            (cert_pem, the certificate bundle or the global CA store), the same rule
            as esp_https_ota.

    config ESP_SUIT_OTA_VERIFY_SPI_MODE
        bool "Check the SPI flash mode of a new app image against the running one"
        default y

endmenu
```

## esp_suit_ota/examples/suit_ota_advanced/main/Kconfig.projbuild
```kconfig
menu "Example Configuration"

    config EXAMPLE_MANIFEST_URL
        string "Manifest URL"
        default "FROM_STDIN"
        help
            URL of the SUIT envelope. FROM_STDIN reads it from the console.

    config EXAMPLE_USE_CERT_BUNDLE
        bool "Use the certificate bundle for the release server"
        default y

    config EXAMPLE_SKIP_COMMON_NAME_CHECK
        bool "Skip the server certificate common name check"
        default n

    config EXAMPLE_HTTP_REQUEST_SIZE
        int "Range chunk size for payload downloads (0 = whole resource per request)"
        default 0

    config EXAMPLE_ENABLE_BLE
        bool "Offer a second transport for components with a ble:// URI"
        depends on BT_NIMBLE_ENABLED
        default y
        help
            The device advertises a GATT service. The OTA loop publishes the resource it needs in
            the request characteristic, and a connected peer writes those bytes into the data
            characteristic. Without this, a ble:// URI fails with ESP_ERR_SUIT_OTA_NO_TRANSPORT.

    config EXAMPLE_BLE_DEVICE_NAME
        string "Name the device advertises"
        depends on EXAMPLE_ENABLE_BLE
        default "suit-ota"

    config EXAMPLE_BLE_RX_BUF
        int "Bytes buffered between the BLE write callback and the OTA loop"
        depends on EXAMPLE_ENABLE_BLE
        default 4096

    config EXAMPLE_BLE_TIMEOUT_MS
        int "How long the getter waits for the next chunk from the peer"
        depends on EXAMPLE_ENABLE_BLE
        default 30000

endmenu
```

## esp_suit_ota/examples/suit_ota_advanced/sdkconfig.defaults
```kconfig
CONFIG_ESPTOOLPY_FLASHSIZE_8MB=y
CONFIG_PARTITION_TABLE_CUSTOM=y
CONFIG_PARTITION_TABLE_CUSTOM_FILENAME="partitions.csv"
CONFIG_PARTITION_TABLE_OFFSET=0x8000
CONFIG_BOOTLOADER_APP_ROLLBACK_CONFIRM_BY_APP=y
CONFIG_ESP_MAIN_TASK_STACK_SIZE=8192
CONFIG_MBEDTLS_CERTIFICATE_BUNDLE=y
CONFIG_ESP_HTTP_CLIENT_ENABLE_GET_CONTENT_RANGE=y
CONFIG_BT_ENABLED=y
CONFIG_BT_NIMBLE_ENABLED=y
```

## esp_suit_ota/test_apps/sdkconfig.defaults
```kconfig
CONFIG_PARTITION_TABLE_CUSTOM=y
CONFIG_PARTITION_TABLE_CUSTOM_FILENAME="partitions.csv"
CONFIG_ESPTOOLPY_FLASHSIZE_4MB=y
CONFIG_ESP_TASK_WDT_EN=n
CONFIG_ESP_MAIN_TASK_STACK_SIZE=8192
CONFIG_ESP_SUIT_OTA_JOURNAL_KB=4
CONFIG_ESP_SUIT_OTA_MAX_COMPONENTS=4
```

## expat/Kconfig
```kconfig
menu "expat"

    config EXPAT_XML_GE
        bool "Enable XML general entity expansion"
        default y
        help
            Compile in general entity expansion plus the billion-laughs and
            allocation-tracker protection that goes with it. Disable it for a
            smaller parser: only the five predefined entities (amp, lt, gt,
            apos, quot) still expand; other &name; stay as that text, and
            external general entities are not loaded.

    config EXPAT_XML_DTD
        bool "Enable XML DTD support"
        default y
        depends on EXPAT_XML_GE
        help
            Compile in external DTD subsets, parameter entities, conditional
            sections, and default attributes from an external subset. Turning
            it off shrinks the library: no external subset is fetched and
            those DTD features are not applied. Requires general entities.

endmenu
```

## jsmn/Kconfig
```kconfig
menu "jsmn"


    config JSMN_PARENT_LINKS
        bool "Enable parent links"
        default n
        help
            You can access parent node of parsed json

    config JSMN_STRICT
        bool "Enable strict mode"
        default n
        help
            Accept exactly the JSON grammar of RFC 8259: separators are
            checked, primitives must be true, false, null or a number as the
            RFC spells it, strings may not contain raw control characters,
            the text must be UTF-8, and there is exactly one top-level value.
            A NUL byte inside the given length is an error, not an end of
            text marker. Without strict mode the tokenizer is permissive.

    config JSMN_STATIC
        bool "Declare JSMN API as static"
        default n
        help
            Declare JSMN API as static (instead of extern)

endmenu
```

## libjpeg-turbo/Kconfig
```kconfig
menu "libjpeg-turbo"

    config LIBJPEG_TURBO_ALLOC_PREFER_SPIRAM
        bool "Prefer PSRAM for libjpeg-turbo allocations"
        depends on SPIRAM
        default y
        help
            Route libjpeg-turbo's memory manager (jpeg_get_large() and
            jpeg_get_small()) to PSRAM first. Internal 8-bit RAM is used as a
            fallback when PSRAM is not initialized or cannot satisfy an
            allocation.

            Large objects (sample rows, coefficient buffers, virtual arrays)
            take most of the memory an encoder or decoder needs, so moving them
            frees the most internal RAM. Small pools hold the per-image control
            structures and Huffman/quantization tables.

            Without this option libjpeg-turbo calls malloc(). With
            CONFIG_SPIRAM_USE_CAPS_ALLOC, malloc() never returns PSRAM; with
            CONFIG_SPIRAM_USE_MALLOC, only requests above
            CONFIG_SPIRAM_MALLOC_ALWAYSINTERNAL do.

            PSRAM is slower than internal RAM, so encode and decode run slower
            with this option enabled.

endmenu
```

## libpng/Kconfig
```kconfig
menu "libpng"

    config LIBPNG_PREFER_PSRAM
        bool "Prefer PSRAM for libpng allocations"
        depends on SPIRAM
        default y
        help
            Route libpng's allocations to PSRAM first. Internal 8-bit RAM is
            used as a fallback when PSRAM is not initialized or cannot satisfy
            an allocation.

            Without this option libpng calls malloc(). With
            CONFIG_SPIRAM_USE_CAPS_ALLOC, malloc() never returns PSRAM; with
            CONFIG_SPIRAM_USE_MALLOC, only requests above
            CONFIG_SPIRAM_MALLOC_ALWAYSINTERNAL do. Enabling this option is
            therefore the only way to move libpng's working buffers out of
            internal RAM in either configuration.

            PSRAM is slower than internal RAM, so decoding and encoding run
            slower with this option enabled.

endmenu
```
